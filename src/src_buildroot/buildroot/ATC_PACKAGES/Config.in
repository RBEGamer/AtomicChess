## src/src_buildroot/buildroot/ATC_PACKAGES/Config.in
```kconfig
    comment "---------- REQUIRED CORE PACKAGES -----------"
	source "package/atcgui/Config.in"
	source "package/atcctl/Config.in"
    comment "-------- OFFLINE GAME SERVER  ---------------"
    source "package/atcsrv/Config.in"
    source "package/atcserverdiscoveryhelper/Config.in"
    comment "---- OFFLINE SERVER CHESS ENGINES -----------"
    source "package/atcchessenginetheolepage/Config.in"
    source "package/atcchessenginestockfish/Config.in"
    source "package/atcchessenginestockdory/Config.in"
    source "package/atcchessengineryan597/Config.in"
    comment "-------- OPTIONAL FEATURES PACKAGES ---------"
    source "package/atcdgt3000/Config.in"
    comment "-----------  DEBUG PACKAGES -----------"
    source "package/atctp/Config.in"
    source "package/atcrpc/Config.in"
    source "package/atcmisc/Config.in"
```

## src/src_buildroot/buildroot/ATC_PACKAGES/atcchessenginestockdory/Config.in
```kconfig
config BR2_PACKAGE_ATCCHESSENGINESTOCKDORY
    bool "ATC_CHESSENGINESTOCKDORY"
    help
        This package contains a UCI compatible chess  engine StockDory and can be used with the offline server.

        https://github.com/TheBlackPlague/StockDory
```

## src/src_buildroot/buildroot/ATC_PACKAGES/atcchessenginetheolepage/Config.in
```kconfig
config BR2_PACKAGE_ATCCHESSENGINETHEOLEPAGE
    bool "ATC_CHESSENGINETHEOLEPAGE"
    help
        This package contains a UCI compatible chess  engine from theoldpage and can be used with the offline server.

        https://github.com/theolepage/chess
```

## src/src_buildroot/buildroot/ATC_PACKAGES/atcgui/Config.in
```kconfig
config BR2_PACKAGE_ATCGUI
    bool "ATC_GUI"
    help
        This package provied the AtomicChessGui Application based on QT5

        http://marcelochsendorf.com
```

## src/src_buildroot/buildroot/ATC_PACKAGES/atcmisc/Config.in
```kconfig
config BR2_PACKAGE_ATCMISC
    bool "ATC_MISC"
    help
        This package adds nessessary libraries for the atc project.
	Its needed for the other ATC packages

        http://marcelochsendorf.com
```

## src/src_buildroot/buildroot/ATC_PACKAGES/atcsrv/Config.in
```kconfig
config BR2_PACKAGE_ATCSRV
    bool "ATC_SERVER"
    help
        This package contains a simplified server written in c++ to allow offline usage of the server

        http://marcelochsendorf.com
```

## src/src_buildroot/buildroot/CUSTOM_PACKAGES/Config.in
```kconfig
menu "AtomicChessPackages"
	source "CUSTOM_PACKAGES/atcgui/Config.in"
	source "CUSTOM_PACKAGES/atctp/Config.in"
	source "CUSTOM_PACKAGES/atcctl/Config.in"
    source "CUSTOM_PACKAGES/atcdgt3000/Config.in"
endmenu
```

## src/src_buildroot/buildroot/CUSTOM_PACKAGES/atcdgt3000/Config.in
```kconfig
config BR2_PACKAGE_ATCDGT3000
    bool "ATC_GT3000"
    help
        This package contains the DGT3000 chess clock extention

        http://marcelochsendorf.com
```

## src/src_buildroot/buildroot/package/atcchessengineryan597/Config.in
```kconfig
config BR2_PACKAGE_ATCCHESSENGINERYAN597
    bool "ATC_CHESSENGINERYAN597"
    help
        This package contains a UCI compatible chess  engine from ryan597 and can be used with the offline server.

        https://github.com/ryan597/chessengine
```

## src/src_buildroot/buildroot/package/atcchessenginestockfish/Config.in
```kconfig
config BR2_PACKAGE_ATCCHESSENGINESTOCKFISH
    bool "ATC_ATCCHESSENGINESTOCKFISH"
    help
        This package contains a UCI compatible chess  engine Stockfish-16 and can be used with the offline server.

        https://github.com/official-stockfish/Stockfish/releases/tag/sf_16
        https://github.com/official-stockfish/Stockfish
```

## src/src_buildroot/buildroot/package/atcctl/Config.in
```kconfig
config BR2_PACKAGE_ATCCTL
    bool "ATC_CONTROLLER"
    help
        This package contains the main control software for a ATC Table.
        The controller controls all hardware and interacts with the Server and the UI (ATCGUI Package)

        http://marcelochsendorf.com
```

## src/src_buildroot/buildroot/package/atcrpc/Config.in
```kconfig
config BR2_PACKAGE_ATCMRPC
    bool "ATC_RPC"
    help
        This package contians a custom rpc lib based on
        https://github.com/rpclib/rpclib
        
        http://marcelochsendorf.com
```

## src/src_buildroot/buildroot/package/atcserverdiscoveryhelper/Config.in
```kconfig
config BR2_PACKAGE_ATCSERVERDISCOVERYHELPER
    bool "ATC_SERVERDISCOVERYHELPER"
    help
        This package contains a network helper daemon, to automatically detect atc servers in the network using udp broadcasts

        http://marcelochsendorf.com
```

## src/src_buildroot/buildroot/package/atctp/Config.in
```kconfig
config BR2_PACKAGE_ATCTP
    bool "ATC_TEST_PACKAGE"
    help
        This package is a test package for verify the buildroot build process using git fetch

        http://marcelochsendorf.com
```

## src/src_buildroot/buildroot/package/atcwiringpi/Config.in
```kconfig
config BR2_PACKAGE_ATCWIRINGPI
    bool "ATC_WIRING_PI"
    help
        This package is a custom install of the popular wiringpi library.
	Its needed for the other ATC packages

        http://marcelochsendorf.com
```

## src/src_buildroot/buildroot/package/curl/Config.in
```kconfig
config BR2_PACKAGE_ATCCURL
	bool "curl binary"
	depends on BR2_PACKAGE_LIBCURL
	help
	  Install curl binary as well
```
